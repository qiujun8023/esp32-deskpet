## main/Kconfig.projbuild
```kconfig
menu "DeskPet Configuration"

    config ESP_WIFI_SSID
        string "SoftAP SSID"
        default "ESP32-DeskPet"
        help
            WiFi SSID used for the softAP.

    config ESP_WIFI_PASSWORD
        string "SoftAP Password"
        default ""
        help
            WiFi password for WPA2-PSK. Leave empty for open network.

    config ESP_MAX_STA_CONN
        int "Maximal STA connections"
        default 4
        range 1 10
        help
            Max number of stations that can connect to the softAP concurrently.

endmenu
```

## sdkconfig.defaults
```kconfig
CONFIG_IDF_TARGET="esp32c3"
CONFIG_FREERTOS_HZ=1000
CONFIG_ESP_MAIN_TASK_STACK_SIZE=4096
CONFIG_ESP_WIFI_SOFTAP_SUPPORT=y
CONFIG_LWIP_DNS_MAX_SERVERS=3
CONFIG_HTTPD_WS_SUPPORT=y
CONFIG_ESP_WIFI_STATIC_RX_BUFFER_NUM=4
CONFIG_ESP_WIFI_DYNAMIC_RX_BUFFER_NUM=8
```
